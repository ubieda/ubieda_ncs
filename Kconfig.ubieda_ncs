## Kconfig.ubieda_ncs
```kconfig
#
# Copyright (c) 2018 Nordic Semiconductor
#
# SPDX-License-Identifier: LicenseRef-Nordic-5-Clause
#

menu "Ubieda's NCS"

rsource "subsys/Kconfig"
rsource "drivers/Kconfig"

endmenu
```

## samples/bluetooth/hci_usb/sample.yaml
```yaml
sample:
  name: Bluetooth USB HCI 
tests:
  test_code.bluetooth.usb_hci:
    build_only: true
    build_on_all: true
    platform_allow: nrf52840dongle_nrf52840
    tags: ci_build
```

## subsys/basic_module/Kconfig
```kconfig
menu "Basic Module"

config BASIC_MODULE
    bool
    default y
    help
      Set up Basic Module with dummy operations to demonstrate libraries linking and setup

endmenu
```

## subsys/bluetooth/services/Kconfig
```kconfig
#
# Copyright (c) 2019 Nordic Semiconductor ASA
#
# SPDX-License-Identifier: LicenseRef-Nordic-5-Clause
#

menu "Bluetooth Services"

config BT_CX_SERVICES
	bool
	help
	  Common Bluetooth GATT Services support modules, required by all Croxel
	  Services.

rsource "Kconfig.cx_endpoint"
rsource "Kconfig.cx_endpoint_client"

endmenu
```

## subsys/bluetooth/services/Kconfig.cx_endpoint
```kconfig
#
# Copyright (c) 2019 Nordic Semiconductor ASA
#
# SPDX-License-Identifier: LicenseRef-Nordic-5-Clause
#

menuconfig BT_CX_ENDPOINT
	bool "Enable CX Endpoint service"
	select BT_CX_SERVICES
	help
	  Enable CX Endpoint service.

if BT_CX_ENDPOINT

module = BT_CX_ENDPOINT
module-str = CX_ENDPOINT
source "${ZEPHYR_BASE}/subsys/logging/Kconfig.template.log_config"

endif # BT_CX_ENDPOINT
```

## subsys/bluetooth/services/Kconfig.cx_endpoint_client
```kconfig
#
# Copyright (c) 2019 Nordic Semiconductor ASA
#
# SPDX-License-Identifier: LicenseRef-Nordic-5-Clause
#

menuconfig BT_CX_ENDPOINT_CLIENT
	bool "CX Endpoint service client"
	select BT_CX_SERVICES
	help
	  Enable CX Endpoint service client.

if BT_CX_ENDPOINT_CLIENT

module = BT_CX_ENDPOINT_CLIENT
module-str = BT_CX_ENDPOINT_CLIENT
source "${ZEPHYR_BASE}/subsys/logging/Kconfig.template.log_config"

endif # BT_NUS_CLIENT
```

## test_code/bluetooth/observer/sample.yaml
```yaml
sample:
  name: Bluetooth Observer Test Code
tests:
  test_code.bluetooth.observer:
    build_only: true
    build_on_all: true
    platform_allow: nrf52833dk_nrf52833
    tags: ci_build
```

## tests/unity/basic/testcase.yaml
```yaml
tests:
  unity.basic_module_test:
    platform_allow: native_posix
    build_on_all: True
    tags: basic
```
